## conf/layer.conf
```bitbake
# We have a conf and classes directory, append to BBPATH
BBPATH .= ":${LAYERDIR}"

# recipes
BBFILES += "${LAYERDIR}/recipes-*/*/*.bb ${LAYERDIR}/recipes-*/*/*/*.bb ${LAYERDIR}/recipes-*/*/*/*/*.bb"
# appends
BBFILES += "${LAYERDIR}/extends-*/*.bb ${LAYERDIR}/extends-*/*.bbappend"

BBFILE_COLLECTIONS += "meta-qt5-extra"
BBFILE_PATTERN_meta-qt5-extra := "^${LAYERDIR}/"
BBFILE_PRIORITY_meta-qt5-extra = "20"

LAYERDEPENDS_meta-qt5-extra = " \
    core \
    qt5-layer \
    openembedded-layer \
    networking-layer \
    multimedia-layer \
    gnome-layer \
    meta-python \
"
LAYERSERIES_COMPAT_meta-qt5-extra = "thud warrior"

LICENSE_PATH += "${LAYERDIR}/files/licenses"

# required for fluxbox - supplied by e.g fedora glibc-common
HOSTTOOLS_NONFATAL += "gencat"
```
